## boards/arm/samd21pad/Kconfig.board
```kconfig
# samd21pad board configuration

# Copyright (c) 2021 Pete Johanson
# SPDX-License-Identifier: Apache-2.0

config BOARD_SAMD21PAD
	bool "samd21pad board"
	depends on SOC_PART_NUMBER_SAMD21E18A
```

## boards/arm/samd21pad/Kconfig.defconfig
```kconfig
# samd21pad board configuration 
# Copyright (c) 2023 Pete Johanson
# SPDX-License-Identifier: Apache-2.0

config BOARD
	default "samd21pad"
	depends on BOARD_SAMD21PAD

config ZMK_USB
	default y if BOARD_SAMD21PAD
```
